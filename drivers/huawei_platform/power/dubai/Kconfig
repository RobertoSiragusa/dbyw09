## drivers/huawei_platform/power/dubai/Kconfig
```kconfig
config POWER_DUBAI_GPU_STATS
	bool "Dubai gpu frequency stats"
	default n
	depends on POWER_DUBAI && HUAWEI_GPU_OPP_STATS
```

## drivers/huawei_platform/power/hardware_ic/Kconfig
```kconfig
source "drivers/huawei_platform/power/hardware_ic/switch_capacitor/Kconfig"
source "drivers/huawei_platform/power/hardware_ic/wireless_charge_ic/Kconfig"
```

## drivers/hw_wlan/Kconfig
```kconfig
config HUAWEI_WIFI
	bool "qca huawei wifi extension"
	default n

config HUAWEI_WIFI_BUILTIN
	bool "qca builtin feature"
	depends on HUAWEI_WIFI
	default n
```

## kernel/hw_pi/Kconfig
```kconfig
config HW_FUTEX_PI
        bool "extend futex pi"
        depends on FUTEX_PI && (HW_QOS_THREAD || HW_RTG_SCHED)
        default n
        help
          Customize futex pi and support qos and vip_prio inheritance.
```

## sound/smartpa/fs19xx/Kconfig
```kconfig
config SND_SOC_FS18XX
    tristate "FourSemi fs18xx Codec Driver"
    depends on I2C
#    default y
    help
      for FourSemi True Smart Amplifier.
```
